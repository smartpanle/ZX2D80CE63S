## main/Kconfig.projbuild
```kconfig
menu "Application Features"

    config APP_ENABLE_RS485
        bool "Enable RS485 demo"
        default y
        help
            Build and start the RS485 demo tasks during app startup.

    config APP_ENABLE_LVGL
        bool "Enable LVGL demo"
        default y
        help
            Build and start the LCD and LVGL demo during app startup.

endmenu
```

## sdkconfig.defaults
```kconfig
CONFIG_IDF_TARGET="esp32c61"
CONFIG_ESPTOOLPY_FLASHSIZE_8MB=y
CONFIG_COMPILER_DISABLE_DEFAULT_ERRORS=y
CONFIG_LV_CONF_SKIP=y
CONFIG_LV_USE_OBSERVER=y
CONFIG_LV_USE_SYSMON=y
CONFIG_LV_USE_DEMO_WIDGETS=y
CONFIG_LV_USE_DEMO_BENCHMARK=y
CONFIG_LV_FONT_MONTSERRAT_14=y
CONFIG_LV_FONT_MONTSERRAT_24=y
```
